/*@!Encoding:1252*/
variables {
  message Encrypted_DoorCmd msg;  // Message declaration  
  dword fileHandle;
  byte encryptedData[24];  
  char buffer[128];  
  char commandString[2];  // Corrected command string  
  int i = 0;
  long value;
  dword index = 0;
  msTimer delayTimer;  
}

// Function to execute Python script
void sendCommandAndReadResponse(char command) {
  commandString[0] = command;
  commandString[1] = '\0';  

  write("? TCU: Running Python script with command: %c", command);

  // Fixed execution command (NO `sprintf`)
  //sysExecCmd("C:/Users/CB.EN.P2AEL24003/Desktop/Mait/CVS/New_ProjectWork/Secured_CAN-FD/script11.py " , commandString);  
  sysExecCmd("start /B python C:/Users/CB.EN.P2AEL24003/Desktop/Mait/CVS/New_ProjectWork/Secured_CAN-FD/script11.py " , commandString);

  write("? TCU: Executed Python script with command: %c", command);
  
  setTimer(delayTimer, 2000);  // Delay before reading the response
}

// Timer event to read encrypted data
on timer delayTimer {
  i = 0;
  index = 0;
  
  fileHandle = openFileRead("C:/Users/CB.EN.P2AEL24003/Desktop/Mait/CVS/New_ProjectWork/Secured_CAN-FD/encrypted_data.bin", 0);
  
  if (fileHandle != 0) {
    write("? TCU: Successfully opened encrypted data file.");

    if (fileGetString(buffer, 128, fileHandle) != 0) {
      while (i < 24 && index < strlen(buffer)) {
        int j = 0;
        char tempStr[4];  

        while (buffer[index] != ' ' && buffer[index] != '\0' && j < 3) {  
          tempStr[j] = buffer[index];
          index++;
          j++;
        }
        tempStr[j] = '\0';  
        
        if (strtol(tempStr, value) != 0) {
          encryptedData[i] = (byte)value;
          i++;
        }
        
        while (buffer[index] == ' ') {  
          index++;
        }
      }
    }
    
    fileClose(fileHandle);

    if (i == 24) {
      write("? TCU: Successfully read encrypted data from file.");
      sendEncryptedData();  
    } else {
      write("? ERROR: Not enough data read from file! Read only %d values", i);
    }
  } else {
    write("? ERROR: Failed to open encrypted data file!");
  }
}

// Function to send message
void sendEncryptedData() {
  int i;
  msg.ID = 0x600;  
  msg.DLC = 24;    

  for (i = 0; i < 24; i++) {
    msg.byte(i) = encryptedData[i];  
  }
  //clearTxBuffer();  // Clears the CAN TX queue
  output(msg);  
  write("? TCU: Sent encrypted command.");
}

// Key press events
on key 'U' {  
  sendCommandAndReadResponse('0');  // Send '0' to unlock
}

on key 'L' {  
  sendCommandAndReadResponse('1');  // Send '1' to lock
}
