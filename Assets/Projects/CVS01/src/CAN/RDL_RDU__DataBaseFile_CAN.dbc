VERSION ""

NS_ :

BS_:

BU_: BCM TCU
VAL_TABLE_ Vehicle_Speed_Value 2 "Speed_100" 1 "Speed_10" 0 "Zero_Speed" ;
VAL_TABLE_ Status_Notification 1 "Operation_Failed" 0 "Operation_Successful" ;
VAL_TABLE_ Current_Door_Status_Value 1 "Currently_Locked" 0 "Currently_Unlocked" ;
VAL_TABLE_ Remote_Door_request_Value_Table 1 "Lock" 0 "Unlock" ;

BO_ 516 Status_Notification_BCM: 2 BCM
 SG_ Operation_Status_Signal : 0|1@1- (1,0) [1|300] "" Vector__XXX

BO_ 514 Door_Status_Update_BCM: 2 BCM
 SG_ DoorStatus : 0|1@1+ (1,0) [0|1] "" Vector__XXX

BO_ 256 Remote_Door_Request: 2 TCU
 SG_ DoorCmd : 0|8@1+ (1,0) [0|1] "" Vector__XXX

BA_DEF_  "BusType" STRING ;
BA_DEF_DEF_  "BusType" "CAN";
VAL_ 516 Operation_Status_Signal 1 "Operation_Failed" 0 "Operation_Successful" ;
VAL_ 514 DoorStatus 1 "Currently_Locked" 0 "Currently_Unlocked" ;
VAL_ 256 DoorCmd 1 "Lock" 0 "Unlock" ;
